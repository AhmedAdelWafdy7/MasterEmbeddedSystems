/*@!Encoding:65001*/
includes
{
  
}

variables
{
  msTimer send_timer;
  const int send_timer_period = 1000;
  message ACC_CMD_Message Acc_CMD;
  int variable_ACC = 0;
}

on start{
  write("ENG. Ahmed Wafdy : Case Study 5 learn-in-depth.com");
    write("Mastering CAN Protocol");
  setTimer(send_timer,send_timer_period);
}
on message Speed_Value_message
{ 
  write("ECU1 : Recieved from ECU2");
}
on timer send_timer
{
  write("Eng. Ahmed Wafdy : Case Study 5 learn-in-depth.com");
    variable_ACC = @sysvar::ACC_System_VAL;
  Acc_CMD.ACC_ON.phys = variable_ACC;
  output(Acc_CMD);
  setTimer(send_timer,send_timer_period);
}